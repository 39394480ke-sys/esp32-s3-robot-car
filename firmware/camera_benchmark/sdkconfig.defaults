## firmware/camera_benchmark/sdkconfig.defaults
```kconfig
CONFIG_IDF_TARGET="esp32s3"

CONFIG_ESPTOOLPY_FLASHMODE_DIO=y
CONFIG_ESPTOOLPY_FLASHMODE="dio"
CONFIG_ESPTOOLPY_FLASHFREQ_80M=y
CONFIG_ESPTOOLPY_FLASHFREQ="80m"
CONFIG_ESPTOOLPY_FLASHSIZE_16MB=y
CONFIG_ESPTOOLPY_FLASHSIZE="16MB"

CONFIG_SPIRAM=y
CONFIG_SPIRAM_MODE_OCT=y
CONFIG_SPIRAM_TYPE_AUTO=y
CONFIG_SPIRAM_SPEED_40M=y
CONFIG_SPIRAM_SPEED=40
CONFIG_SPIRAM_BOOT_INIT=y
CONFIG_SPIRAM_USE_MALLOC=y
CONFIG_SPIRAM_MEMTEST=y
CONFIG_SPIRAM_MALLOC_ALWAYSINTERNAL=16384
CONFIG_SPIRAM_MALLOC_RESERVE_INTERNAL=32768

CONFIG_ESP_CONSOLE_USB_SERIAL_JTAG=y
CONFIG_ESP_CONSOLE_SECONDARY_NONE=y

CONFIG_CAMERA_JPEG_MODE_FRAME_SIZE_CUSTOM=y
CONFIG_CAMERA_JPEG_MODE_FRAME_SIZE=8192
```

## firmware/camera_streaming/main/Kconfig.projbuild
```kconfig
menu "Robot Wi-Fi"

    config ROBOT_ID
        string "Robot identifier"
        default "robot-01"

    config ROBOT_WIFI_SSID
        string "Wi-Fi SSID"
        default ""

    config ROBOT_WIFI_PASSWORD
        string "Wi-Fi password"
        default ""

    config D2_WIFI_RECONNECT_SELF_TEST
        bool "Run one controlled Wi-Fi reconnect after bring-up"
        default n

endmenu
```

## firmware/robot_control/main/Kconfig.projbuild
```kconfig
menu "Robot control"

config ROBOT_LEFT_MOTOR_INVERTED
    bool "Invert the left motor direction"
    default n
    help
        Reverse the left motor's logical forward direction without changing
        the documented wiring.

config ROBOT_RIGHT_MOTOR_INVERTED
    bool "Invert the right motor direction"
    default y
    help
        Reverse the right motor's logical forward direction without changing
        the documented wiring.

config ROBOT_WIFI_SSID
    string "Wi-Fi SSID"
    default ""

config ROBOT_WIFI_PASSWORD
    string "Wi-Fi password"
    default ""

menu "Gimbal"

config ROBOT_YAW_MIN_DEGREES
    int "Yaw minimum angle"
    range 0 180
    default 45

config ROBOT_YAW_CENTER_DEGREES
    int "Yaw center angle"
    range 0 180
    default 90

config ROBOT_YAW_MAX_DEGREES
    int "Yaw maximum angle"
    range 0 180
    default 135

config ROBOT_YAW_INVERTED
    bool "Invert yaw servo output"
    default y

config ROBOT_YAW_TRIM_DEGREES
    int "Yaw mechanical trim"
    range -90 90
    default 14

config ROBOT_PITCH_MIN_DEGREES
    int "Pitch minimum angle"
    range 0 180
    default 60

config ROBOT_PITCH_CENTER_DEGREES
    int "Pitch center angle"
    range 0 180
    default 90

config ROBOT_PITCH_MAX_DEGREES
    int "Pitch maximum angle"
    range 0 180
    default 120

config ROBOT_PITCH_INVERTED
    bool "Invert pitch servo output"
    default n

endmenu

endmenu
```

## firmware/robot_control/sdkconfig.defaults
```kconfig
CONFIG_IDF_TARGET="esp32s3"
CONFIG_ESPTOOLPY_FLASHSIZE_16MB=y
CONFIG_ESPTOOLPY_FLASHSIZE="16MB"
CONFIG_COMPILER_OPTIMIZATION_DEBUG=y
CONFIG_LOG_DEFAULT_LEVEL_INFO=y
CONFIG_ROBOT_RIGHT_MOTOR_INVERTED=y
CONFIG_ROBOT_YAW_MIN_DEGREES=45
CONFIG_ROBOT_YAW_CENTER_DEGREES=90
CONFIG_ROBOT_YAW_MAX_DEGREES=135
CONFIG_ROBOT_YAW_INVERTED=y
CONFIG_ROBOT_YAW_TRIM_DEGREES=14
CONFIG_ROBOT_PITCH_MIN_DEGREES=60
CONFIG_ROBOT_PITCH_CENTER_DEGREES=90
CONFIG_ROBOT_PITCH_MAX_DEGREES=120
```
